## app/tests/sim/wst_sensor_sim/testcase.yaml
```yaml
common:
  tags: simulation
  integration_platforms:
    - native_sim
  harness: console
  harness_config:
    type: multi_line
    regex:
      - "WST simulation run successfully"
tests:
  wst.simulation:
    platform_allow:
      - native_sim
    tags: simulation
```

## app/tests/unit/wst_cayenne_lpp/decode/testcase.yaml
```yaml
common:
  tags:
    cayenne_lpp decode
tests:
  cayenne_lpp.decode:
    type: unit
```

## app/tests/unit/wst_cayenne_lpp/encode/testcase.yaml
```yaml
common:
  tags:
    cayenne_lpp encode
tests:
  cayenne_lpp.encode:
    type: unit
```
